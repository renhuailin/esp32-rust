## sdkconfig.defaults
```kconfig
# 覆盖项目名称
CONFIG_APP_PROJECT_NAME="xiaoxin_esp32"

# 覆盖版本号
CONFIG_APP_PROJECT_VER="0.1.1"
CONFIG_APP_PROJECT_VER_FROM_CONFIG=y

# Rust often needs a bit of an extra main task stack size compared to C (the default is 3K)

CONFIG_ESP_MAIN_TASK_STACK_SIZE=32768

# Use this to set FreeRTOS kernel tick frequency to 1000 Hz (100 Hz by default).

# This allows to use 1 ms granularity for thread sleeps (10 ms by default).

#CONFIG_FREERTOS_HZ=1000

# Workaround for https://github.com/espressif/esp-idf/issues/7631

#CONFIG_MBEDTLS_CERTIFICATE_BUNDLE=n
#CONFIG_MBEDTLS_CERTIFICATE_BUNDLE_DEFAULT_FULL=n

# 设置默认日志级别

# 0: No output

# 1: Error

# 2: Warning

# 3: Info (默认)

# 4: Debug

# 5: Verbose

CONFIG_LOG_DEFAULT_LEVEL=4

CONFIG_WS_TRANSPORT=y
CONFIG_WS_BUFFER_SIZE=8192
CONFIG_WEBSOCKET_CLIENT_TASK_STACK=8192

CONFIG_PARTITION_TABLE_CUSTOM=y
CONFIG_PARTITION_TABLE_CUSTOM_FILENAME="/Users/harley/workspaces/Projects/xiaozhi/xiaoxin_esp32_rust/partitions/v1/16m.csv"
CONFIG_PARTITION_TABLE_OFFSET=0x8000

CONFIG_ESPTOOLPY_FLASHSIZE_16MB=y
CONFIG_ESPTOOLPY_FLASHMODE_QIO=y

CONFIG_ESP_DEFAULT_CPU_FREQ_MHZ_240=y

CONFIG_SPIRAM=y
CONFIG_SPIRAM_MODE_OCT=y
CONFIG_SPIRAM_SPEED_80M=y
CONFIG_SPIRAM_MALLOC_ALWAYSINTERNAL=512
CONFIG_SPIRAM_MALLOC_RESERVE_INTERNAL=65536
CONFIG_SPIRAM_MEMTEST=n
CONFIG_SPIRAM_ALLOW_STACK_EXTERNAL_MEMORY=y
CONFIG_MBEDTLS_EXTERNAL_MEM_ALLOC=y

CONFIG_ESP32S3_INSTRUCTION_CACHE_32KB=y
CONFIG_ESP32S3_DATA_CACHE_64KB=y
CONFIG_ESP32S3_DATA_CACHE_LINE_64B=y

CONFIG_SR_WN_WN9_NIHAOXIAOZHI_TTS=y

# CONFIG_ESP_SYSTEM_EVENT_TASK_STACK_SIZE=4096


#
# Extra
#
CONFIG_FREERTOS_TASK_CREATE_ALLOW_EXT_MEM=y
# end of Extra

CONFIG_FREERTOS_PORT=y
CONFIG_FREERTOS_NO_AFFINITY=0x7FFFFFFF
CONFIG_FREERTOS_SUPPORT_STATIC_ALLOCATION=y
CONFIG_FREERTOS_DEBUG_OCDAWARE=y
CONFIG_FREERTOS_ENABLE_TASK_SNAPSHOT=y
CONFIG_FREERTOS_PLACE_SNAPSHOT_FUNS_INTO_FLASH=y
CONFIG_FREERTOS_NUMBER_OF_CORES=2
# end of FreeRTOS

# 增加内部 SRAM 的保留量（例如给 WiFi/DMA 留出 64KB）
CONFIG_SPIRAM_MALLOC_RESERVE_INTERNAL=65536
```
